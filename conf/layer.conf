## conf/layer.conf
```bitbake
# We have a conf and classes directory, add to BBPATH
BBPATH .= ":${LAYERDIR}"

# We have recipes-* directories, add to BBFILES
BBFILES += "${LAYERDIR}/recipes-*/*/*.bb \
${LAYERDIR}/recipes-*/*/*.bbappend"

BBFILE_COLLECTIONS += "iceoryx"
BBFILE_PATTERN_iceoryx = "^${LAYERDIR}/"
BBFILE_PRIORITY_iceoryx = "20"

LAYERSERIES_COMPAT_iceoryx = "dunfell" 
```
